## app/dts/bindings/input_processors/zmk,input-processor-touch-stream-scroll.yaml
```yaml
# Copyright (c) 2026 The ZMK Contributors
# SPDX-License-Identifier: MIT

description: |
  Marker input processor for the raw touch stream (CONFIG_ZMK_TOUCH_STREAM).

  Passes events through unchanged. Its presence in an input listener's
  processor chain marks a "scroll context" for the touch-stream module:
  while the chain containing this processor would handle events from a
  streaming pad (i.e. it is the listener's base chain, or a layer overlay
  whose layer is currently active), the pad's streamed frames carry the
  scroll-mode flag.

compatible: "zmk,input-processor-touch-stream-scroll"

include: ip_zero_param.yaml
```

## app/src/pointing/Kconfig
```kconfig
# Copyright (c) 2024 The ZMK Contributors
# SPDX-License-Identifier: MIT

menu "Pointing Options"

# Deprecated old config, kept for backwards compat
config ZMK_MOUSE
    bool "(Deprecated) Mouse Support"

config ZMK_POINTING
    bool "Pointing Device Support"
    default y if ZMK_MOUSE
    select INPUT
    select INPUT_THREAD_PRIORITY_OVERRIDE

if ZMK_POINTING

# Needed for anyone using gpio-keys for things like soft-off setup.
config INPUT_GPIO_KEYS
    default n

config INPUT_THREAD_STACK_SIZE
    default 1024 if ZMK_SPLIT && !ZMK_SPLIT_ROLE_CENTRAL

if !ZMK_SPLIT || ZMK_SPLIT_ROLE_CENTRAL

config ZMK_POINTING_SMOOTH_SCROLLING
    bool "Smooth Scrolling"
    help
      Enable smooth scrolling, with hosts that support HID Resolution Multipliers

config ZMK_INPUT_LISTENER
    bool "Input listener for processing input events in the system"
    default y
    depends on DT_HAS_ZMK_INPUT_LISTENER_ENABLED


config ZMK_INPUT_PROCESSOR_TEMP_LAYER
    bool "Temporary Layer Input Processor"
    default y
    depends on DT_HAS_ZMK_INPUT_PROCESSOR_TEMP_LAYER_ENABLED

config ZMK_INPUT_PROCESSOR_TEMP_LAYER_MAX_ACTION_EVENTS
    int "Temporary Layer Input Processor Max Action Events"
    default 4
    depends on ZMK_INPUT_PROCESSOR_TEMP_LAYER

config ZMK_TOUCH_STREAM
    bool "Stream raw absolute touch frames over a vendor HID report"
    default n
    depends on DT_HAS_CIRQUE_PINNACLE_ENABLED
    help
      Stream absolute touch frames (position + touch strength) from a
      Cirque Pinnacle trackpad running in absolute mode (abs-mode
      devicetree property) to the host over a vendor-defined HID report,
      over both USB and BLE. While the configured scroll layer is active,
      the pad's motion is withheld from the normal pointer pipeline so the
      host can synthesize scrolling from the raw frames; otherwise
      relative deltas are derived in firmware and fed to the existing
      input listener chain.

config ZMK_TOUCH_STREAM_SCROLL_LAYER
    int "Keymap layer that marks touch stream frames as scroll mode"
    default 2
    depends on ZMK_TOUCH_STREAM

endif

config ZMK_INPUT_PROCESSOR_TRANSFORM
    bool "Transform Input Processor"
    default y
    depends on DT_HAS_ZMK_INPUT_PROCESSOR_TRANSFORM_ENABLED

config ZMK_INPUT_PROCESSOR_SCALER
    bool "Scaling Input Processor"
    default y
    depends on DT_HAS_ZMK_INPUT_PROCESSOR_SCALER_ENABLED

config ZMK_INPUT_PROCESSOR_CODE_MAPPER
    bool "Code Mapper Input Processor"
    default y
    depends on DT_HAS_ZMK_INPUT_PROCESSOR_CODE_MAPPER_ENABLED

config ZMK_INPUT_PROCESSOR_BEHAVIORS
    bool "Behaviors Input Processor"
    default y
    depends on DT_HAS_ZMK_INPUT_PROCESSOR_BEHAVIORS_ENABLED

config ZMK_INPUT_SPLIT
    bool "Split input support"
    default y
    depends on DT_HAS_ZMK_INPUT_SPLIT_ENABLED && ZMK_SPLIT

if ZMK_INPUT_SPLIT

config ZMK_INPUT_SPLIT_INIT_PRIORITY
    int "Input Split initialization priority"
    default INPUT_INIT_PRIORITY

endif # ZMK_INPUT_SPLIT

endif # ZMK_POINTING

endmenu # Mouse Options
```

## app/west.yml
```yaml
manifest:
  remotes:
    - name: zephyrproject-rtos
      url-base: https://github.com/zephyrproject-rtos
    - name: zmkfirmware
      url-base: https://github.com/zmkfirmware
    - name: petejohanson
      url-base: https://github.com/petejohanson
    - name: kalakris
      url-base: https://github.com/kalakris
  projects:
    - name: zephyr
      remote: zmkfirmware
      revision: v3.5.0+zmk-fixes
      clone-depth: 1
      import:
        name-blocklist:
          - ci-tools
          - hal_altera
          - hal_cypress
          - hal_infineon
          - hal_microchip
          - hal_nxp
          - hal_openisa
          - hal_silabs
          - hal_xtensa
          - hal_st
          - hal_ti
          - loramac-node
          - mcuboot
          - mcumgr
          - net-tools
          - openthread
          - edtt
          - trusted-firmware-m
    - name: nanopb
      revision: 8c60555d6277a0360c876bd85d491fc4fb0cd74a
      path: modules/lib/nanopb
      remote: zmkfirmware
    - name: zmk-studio-messages
      revision: 6cb4c283e76209d59c45fbcb218800cd19e9339d
      path: modules/msgs/zmk-studio-messages
      remote: zmkfirmware
    - name: cirque-input-module
      remote: kalakris
      # EXPERIMENT: upstream Zephyr v4.1.0 in-tree input_pinnacle driver
      # vendored as an out-of-tree module (see intree-driver-test branch).
      revision: intree-driver-test
  self:
    west-commands: scripts/west-commands.yml
```
